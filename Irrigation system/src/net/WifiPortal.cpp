#include "net/WifiPortal.h"
#include <ESPmDNS.h>
#include <Preferences.h>
#include <ArduinoJson.h>
#include <algorithm>
#include "AppPage.h"      // controller UI (station mode), generated by tools/build_pages.py
#include "PortalPage.h"   // setup page (AP mode)
#include "util/Util.h"

namespace {
constexpr uint32_t CONNECT_TIMEOUT_MS = 30000;   // saved network: give up and open the setup AP
constexpr uint32_t PRESCAN_TIMEOUT_MS = 20000;   // stop waiting for the first scan, open the AP anyway
constexpr uint32_t AP_RETRY_PERIOD_MS = 60000;   // setup AP: retry the saved network...
constexpr uint32_t AP_RETRY_WINDOW_MS = 15000;   // ...for this long, only while nobody is on the AP
constexpr uint32_t RESTART_DELAY_MS   = 1000;    // let the browser get the reply, then reboot
constexpr uint8_t  SCAN_MAX_RETRIES   = 3;
constexpr const char* AP_PREFIX = "Irrigation-Setup-";

uint32_t since(uint32_t t) { return (uint32_t)(millis() - t); }

// ---- validation (the server checks again whatever the page checked) ----
bool validUtf8(const String& s) {
  const uint8_t* p = (const uint8_t*)s.c_str();
  size_t n = s.length(), i = 0;
  while (i < n) {
    uint8_t c = p[i];
    size_t extra = c < 0x80 ? 0 : (c >= 0xC2 && c <= 0xDF) ? 1 : ((c & 0xF0) == 0xE0) ? 2 : (c >= 0xF0 && c <= 0xF4) ? 3 : 99;
    if (extra == 99) return false;
    if (extra > 0 && i + extra >= n) return false;   // cut off
    for (size_t j = 1; j <= extra; j++) if ((p[i + j] & 0xC0) != 0x80) return false;
    i += extra + 1;
  }
  return true;
}

// SSID: 1..32 bytes, valid UTF-8, no control characters
bool validSsid(const String& s) {
  if (s.length() < 1 || s.length() > 32) return false;
  for (size_t i = 0; i < s.length(); i++) {
    uint8_t c = (uint8_t)s[i];
    if (c < 0x20 || c == 0x7F) return false;
  }
  return validUtf8(s);
}

// Password: empty (open network) or 8..63 printable ASCII
bool validPass(const String& p) {
  if (p.length() == 0) return true;
  if (p.length() < 8 || p.length() > 63) return false;
  for (size_t i = 0; i < p.length(); i++) {
    uint8_t c = (uint8_t)p[i];
    if (c < 0x20 || c > 0x7E) return false;
  }
  return true;
}

const char* reasonText(uint8_t r) {
  switch (r) {
    case 2:   return "authentication expired";
    case 3:   return "the access point disconnected us";
    case 15:  return "4-way handshake timeout (wrong password?)";
    case 200: return "lost the signal";
    case 201: return "network not found (off? 5 GHz only? name typo?)";
    case 202: return "authentication failed (wrong password? WPA3-only?)";
    case 204: return "handshake timeout (wrong password?)";
    default:  return "other";
  }
}

void diag(arduino_event_id_t, arduino_event_info_t info) {
  static uint8_t last = 0;
  static uint32_t t = 0;
  uint8_t r = info.wifi_sta_disconnected.reason;
  if (r == last && since(t) < 5000) return;   // the SDK retries every few seconds
  last = r;
  t = millis();
  Serial.printf("WiFi: not connected, reason %u: %s\n", (unsigned)r, reasonText(r));
}
}  // namespace

// ---------------- lifecycle ----------------
void WifiPortal::begin(bool forceAp, const char* hostname) {
  copyStr(_host, sizeof(_host), hostname);
  WiFi.persistent(false);        // credentials live in our own NVS namespace
  WiFi.onEvent(diag, ARDUINO_EVENT_WIFI_STA_DISCONNECTED);
  loadCreds();
  registerRoutes();

  Preferences p;                 // "Change WiFi network" from the UI asked for the setup AP
  bool setupReq = false;
  if (p.begin("wifi", false)) {
    setupReq = p.getUChar("setup", 0);
    if (setupReq) p.remove("setup");
    p.end();
  }

  if (forceAp) { Serial.println("WiFi: service mode, setup AP"); startAp(true); }
  else if (setupReq || _ssid.length() == 0) { Serial.println("WiFi: setup AP"); startAp(false); }
  else startSta();
}

void WifiPortal::update() {
  switch (_mode) {
    case Mode::CONNECTING:
      if (WiFi.status() == WL_CONNECTED) onConnected();
      else if (since(_tMode) >= CONNECT_TIMEOUT_MS) {
        Serial.println("WiFi: no connection within 30 s, opening the setup AP");
        _connectFailed = true;
        startAp(false);
      }
      break;
    case Mode::STA:
      trackConnection();
      _server.handleClient();
      break;
    case Mode::PRESCAN:
      pollScan();
      if (!_scanning) openAp();
      else if (since(_tMode) >= PRESCAN_TIMEOUT_MS) { _scanning = false; WiFi.scanDelete(); openAp(); }
      break;
    case Mode::AP:
      _dns.processNextRequest();
      _server.handleClient();
      pollScan();
      apRetry();
      break;
    default:
      break;
  }
  if (_restartPending && (int32_t)(millis() - _restartAt) >= 0) restart("WiFi: restarting");
}

void WifiPortal::restart(const char* why) {
  Serial.println(why);
  delay(50);
  ESP.restart();
}

void WifiPortal::setHostname(const char* name) {
  copyStr(_host, sizeof(_host), name);
  if (_mode == Mode::STA) {
    WiFi.setHostname(_host);
    startMdns();
  }
}

void WifiPortal::resetToSetup() {
  Preferences p;
  if (p.begin("wifi", false)) { p.putUChar("setup", 1); p.end(); }
  _restartPending = true;
  _restartAt = millis() + RESTART_DELAY_MS;
}

// ---------------- credentials ----------------
void WifiPortal::loadCreds() {
  Preferences p;
  p.begin("wifi", false);
  _ssid = p.getString("ssid", "");
  _pass = p.getString("pass", "");
  p.end();
  if (!validSsid(_ssid) || !validPass(_pass)) { _ssid = ""; _pass = ""; }
}

bool WifiPortal::saveCreds(const String& ssid, const String& pass) {
  Preferences p;
  if (!p.begin("wifi", false)) return false;
  p.putString("ssid", ssid);
  p.putString("pass", pass);
  bool ok = p.getString("ssid", "") == ssid && p.getString("pass", "") == pass;
  p.end();
  return ok;
}

// ---------------- station ----------------
void WifiPortal::startSta() {
  _mode = Mode::CONNECTING;
  _tMode = millis();
  WiFi.mode(WIFI_STA);
  WiFi.setHostname(_host);            // after mode(STA), before begin
  WiFi.setSleep(false);               // mains powered: keeps mDNS and the page responsive
  WiFi.setAutoReconnect(true);
  WiFi.begin(_ssid.c_str(), _pass.c_str());
  Serial.printf("WiFi: connecting to \"%s\"\n", _ssid.c_str());
}

void WifiPortal::onConnected() {
  _mode = Mode::STA;
  ensureServer();
  startMdns();
  _wasUp = true;
  Serial.printf("WiFi: connected, IP %s, http://%s.local/\n", WiFi.localIP().toString().c_str(), _host);
  if (_onConnect) _onConnect();
}

void WifiPortal::trackConnection() {
  bool up = WiFi.status() == WL_CONNECTED;
  if (up && !_wasUp) {
    startMdns();
    Serial.printf("WiFi: reconnected, IP %s\n", WiFi.localIP().toString().c_str());
    if (_onConnect) _onConnect();
  } else if (!up && _wasUp) {
    Serial.println("WiFi: connection lost, retrying automatically");
  }
  _wasUp = up;
}

void WifiPortal::startMdns() {
  if (_mdnsOn) MDNS.end();
  _mdnsOn = MDNS.begin(_host);
  if (_mdnsOn) MDNS.addService("http", "tcp", 80);
}

// ---------------- setup access point ----------------
// Scan first with no AP running: once a phone is on the AP, scans fail or come back empty.
void WifiPortal::startAp(bool forced) {
  _apForced = forced;
  _retrying = false;
  _tRetry = millis();
  WiFi.disconnect(false, false);
  WiFi.mode(WIFI_STA);
  delay(100);                         // let the STA interface come up, otherwise the scan fails with -2
  WiFi.setSleep(false);
  WiFi.setAutoReconnect(false);       // background reconnect scans hop channels and drop AP clients
  _mode = Mode::PRESCAN;
  _tMode = millis();
  _scanRetries = 0;
  startScan();
}

void WifiPortal::openAp() {
  WiFi.mode(WIFI_AP_STA);             // keep the STA half for "Scan again"
  WiFi.setSleep(false);
  uint8_t mac[6];
  WiFi.macAddress(mac);
  char name[40];
  snprintf(name, sizeof(name), "%s%02X%02X", AP_PREFIX, mac[4], mac[5]);
  WiFi.softAP(name, nullptr, 1, 0, 4);   // open, channel 1, max 4 clients
  delay(200);
  const IPAddress ip(192, 168, 4, 1);
  WiFi.softAPConfig(ip, ip, IPAddress(255, 255, 255, 0));
  _dns.setErrorReplyCode(DNSReplyCode::NoError);
  _dns.start(53, "*", ip);            // captive portal: every name resolves to us
  _mode = Mode::AP;
  ensureServer();
  Serial.printf("WiFi: setup AP \"%s\", http://192.168.4.1/\n", name);
}

// After a failed connection, with nobody on the AP, retry the saved network now and then
void WifiPortal::apRetry() {
  if (_apForced || _restartPending || _ssid.length() == 0) return;
  uint8_t clients = WiFi.softAPgetStationNum();
  if (!_retrying) {
    if (clients == 0 && !_scanning && since(_tRetry) >= AP_RETRY_PERIOD_MS) {
      WiFi.begin(_ssid.c_str(), _pass.c_str());
      _retrying = true;
      _tTry = millis();
    }
    return;
  }
  if (clients > 0) stopRetry();
  else if (WiFi.status() == WL_CONNECTED) restart("WiFi: saved network is back, restarting");
  else if (since(_tTry) >= AP_RETRY_WINDOW_MS) stopRetry();
}

void WifiPortal::stopRetry() {
  WiFi.disconnect(false, false);
  _retrying = false;
  _tRetry = millis();
}

// ---------------- scan (async) ----------------
void WifiPortal::startScan() {
  WiFi.scanDelete();
  WiFi.scanNetworks(true, false);
  _scanning = true;
}

void WifiPortal::resetRadio() {        // only before the AP exists: it would drop the phone
  WiFi.scanDelete();
  WiFi.mode(WIFI_OFF);
  delay(100);
  WiFi.mode(WIFI_STA);
  delay(100);
  WiFi.setSleep(false);
  WiFi.setAutoReconnect(false);
}

void WifiPortal::pollScan() {
  if (!_scanning) return;
  int n = WiFi.scanComplete();
  if (n == WIFI_SCAN_RUNNING) return;
  if (n <= 0 && _scanRetries < SCAN_MAX_RETRIES) {
    _scanRetries++;
    if (_mode == Mode::PRESCAN) resetRadio();
    startScan();
    return;
  }
  _scanning = false;
  if (n <= 0 && _netCount > 0) { WiFi.scanDelete(); return; }   // failed rescan: keep the old list
  collectNetworks(n);
  WiFi.scanDelete();
}

void WifiPortal::collectNetworks(int n) {
  _netCount = 0;
  for (int i = 0; i < n; i++) {
    String name = WiFi.SSID(i);
    if (!validSsid(name)) continue;    // hidden or odd names: typed by hand
    addNet(name, (int8_t)WiFi.RSSI(i), WiFi.encryptionType(i) == WIFI_AUTH_OPEN);
  }
  std::sort(_nets, _nets + _netCount, [](const Net& a, const Net& b) { return a.rssi > b.rssi; });
}

void WifiPortal::addNet(const String& name, int8_t rssi, bool open) {
  for (uint8_t i = 0; i < _netCount; i++) {
    if (_nets[i].ssid != name) continue;
    if (rssi > _nets[i].rssi) { _nets[i].rssi = rssi; _nets[i].open = open; }
    return;
  }
  if (_netCount < MAX_NETS) _nets[_netCount++] = Net{name, rssi, open};
}

// ---------------- web server ----------------
void WifiPortal::ensureServer() {
  if (_serverOn) return;
  _server.begin();
  _serverOn = true;
}

void WifiPortal::sendPage(const uint8_t* gz, size_t len, const char* cache) {
  _server.sendHeader("Content-Encoding", "gzip");
  _server.sendHeader("Cache-Control", cache);
  _server.send_P(200, "text/html; charset=utf-8", (PGM_P)gz, len);
}

void WifiPortal::registerRoutes() {
  // "/" is the setup page in AP mode, otherwise the controller UI
  _server.on("/", HTTP_GET, [this]() {
    if (_mode == Mode::AP) sendPage(PORTAL_GZ, PORTAL_GZ_LEN, "max-age=600");
    else sendPage(APP_GZ, APP_GZ_LEN, "max-age=60");   // short: a firmware update ships a new page
  });
  _server.on("/health", HTTP_GET, [this]() {
    _server.sendHeader("Cache-Control", "no-store");
    _server.send(200, "text/plain; charset=utf-8", _health ? _health() : String("ok\n"));
  });
  _server.on("/ping", HTTP_GET, [this]() {
    _server.sendHeader("Access-Control-Allow-Origin", "*");
    _server.send(200, "text/plain", _mode == Mode::AP ? "ap" : "ok");
  });
  _server.on("/favicon.ico", HTTP_GET, [this]() { _server.send(204); });

  // Phones probe these to detect a captive portal; a redirect opens the setup page
  for (const char* probe : {"/generate_204", "/gen_204", "/hotspot-detect.html", "/library/test/success.html",
                            "/connecttest.txt", "/ncsi.txt", "/redirect", "/canonical.html"}) {
    _server.on(probe, HTTP_GET, [this]() { if (_mode == Mode::AP) redirectHome(); else notFound(); });
  }
  _server.on("/scan", HTTP_GET, [this]() { if (_mode == Mode::AP) sendScan(); else notFound(); });
  _server.on("/rescan", HTTP_GET, [this]() {
    if (_mode != Mode::AP) { notFound(); return; }
    if (_retrying) stopRetry();
    _scanRetries = 0;
    startScan();
    _server.send(200, "text/plain", "ok");
  });
  _server.on("/save", HTTP_POST, [this]() { handleSave(); });

  if (_routes) _routes(_server);     // the controller API (refuses to answer outside station mode)

  _server.onNotFound([this]() { if (_mode == Mode::AP) redirectHome(); else notFound(); });
}

void WifiPortal::notFound() { _server.send(404, "text/plain", "not found"); }

void WifiPortal::redirectHome() {
  _server.sendHeader("Location", "http://192.168.4.1/", true);
  _server.sendHeader("Cache-Control", "no-store");
  _server.send(302, "text/plain", "");
}

void WifiPortal::sendJson(const String& j) {
  _server.sendHeader("Cache-Control", "no-store");
  _server.send(200, "application/json", j);
}

// {"w":1} while scanning, else {"w":0,"f":0|1,"v":saved ssid,"h":hostname,"n":[{"s","r","o"}]}
void WifiPortal::sendScan() {
  JsonDocument d;
  if (_scanning) {
    d["w"] = 1;
  } else {
    d["w"] = 0;
    d["f"] = _connectFailed ? 1 : 0;
    d["v"] = _ssid;
    d["h"] = _host;
    JsonArray n = d["n"].to<JsonArray>();
    for (uint8_t i = 0; i < _netCount; i++) {
      JsonObject o = n.add<JsonObject>();
      o["s"] = _nets[i].ssid;
      o["r"] = _nets[i].rssi;
      o["o"] = _nets[i].open ? 1 : 0;
    }
  }
  String out;
  serializeJson(d, out);
  sendJson(out);
}

void WifiPortal::handleSave() {
  if (_mode != Mode::AP) { notFound(); return; }
  String ssid = _server.arg("ssid");
  ssid.trim();                         // stray spaces from keyboards; the password is never trimmed
  String pass = _server.arg("pass");
  if (!validSsid(ssid)) { sendJson("{\"e\":\"ssid\"}"); return; }
  if (!validPass(pass)) { sendJson("{\"e\":\"pass\"}"); return; }
  if (!saveCreds(ssid, pass)) { sendJson("{\"e\":\"save\"}"); return; }
  Serial.printf("WiFi: saved credentials for \"%s\"\n", ssid.c_str());
  sendJson("{\"ok\":1}");
  _restartPending = true;
  _restartAt = millis() + RESTART_DELAY_MS;
}
